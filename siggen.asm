; ------------------------------------------------------------------------------
; test.asm
;
; Blinks an LED on PD0 (digital out 0)
; ------------------------------------------------------------------------------

.include "./m328Pdef.inc"

; ------------------------------------------------------------------------------
; Interrupt vector table

.cseg

.org 0x0000
	rjmp	reset   ; RESET
	reti
	reti            ; INT0
	reti
	reti            ; INT1
	reti
	reti            ; PCINT0
	reti
	reti            ; PCINT1
	reti
	reti            ; PCINT2
	reti
	reti            ; WDT
	reti
	reti            ; TIMER2 COMPA
	reti
	reti            ; TIMER2 COMPB
	reti
	reti            ; TIMER2 OVF
	reti
	reti            ; TIMER1 CAPT
	reti
	reti            ; TIMER1 COMPA
	reti
	reti            ; TIMER1 COMPB
	reti
	reti            ; TIMER1 OVF
	reti
	reti            ; TIMER0 COMPA
	reti
	reti            ; TIMER0 COMPB
	reti
	reti            ; TIMER0 OVF
	reti
	reti            ; SPI, STC
	reti
	reti            ; USART, RX
	reti
	reti            ; USART, UDRE
	reti
	reti            ; USART, TX
	reti
	reti            ; ADC
	reti
	reti            ; EE READY
	reti
	reti            ; ANALOG COMP
	reti
	reti            ; TWI
	reti
	reti            ; SPM READY
	reti


; ------------------------------------------------------------------------------
; Reset entry point

reset:
	; ----- Disable interrupts and set stack pointer to top of SRAM

	eor	r25, r25
	out	SREG, r25
	ldi	r25, HIGH(RAMEND)
	ldi	r24, LOW(RAMEND)
	out	SPH, r25
	out	SPL, r24

	; ----- Set up PORTD for outputting samples, initial output to center of range

	ldi	r25, 0x80
	out	PORTD, r25
	ldi	r25, 0xff
	out	DDRD, r25

	; ----- Set up ADC for reading the frequency knob

	; ADEN  <= 1  Enable ADC
	; ADSC  <= 0  Do not start conversion
	; ADATE <= 0  Do not autotrigger
	; ADIF  <= 1  Clear any pending interrupt flags (just in case)
	; ADIE  <= 0  Disable ADC interrupts (we will poll ADIF)
	; ADPS  <= 7  System clock 16MHz, ADC requres <= 200kHz, scale by 128
	ldi	r25, (1 << ADEN)  | \
		     (0 << ADSC)  | \
		     (0 << ADATE) | \
		     (1 << ADIF)  | \
		     (0 << ADIE)  | \
		     (7 << ADPS0)
	sts	ADCSRA, r25

	; REFS  <= 0  Use AREF as reference
	; ADLAR <= 1  Left-justify ADC results (debug only)
	; MUX   <= 0  Select input ADC0
	ldi	r25, (0 << REFS0) | \
		     (1 << ADLAR) | \
		     (0 << MUX0)
	sts	ADMUX, r25

	; Disable digital input on ADC pin
	lds	r25, DIDR0
	andi	r25, ~(1 << ADC0D)
	sts	DIDR0, r25

	; ADCSRB is for the comparator and autotrigger, neither are active

	; ----- Set up button pin and timer for switching waveforms

	; ----- Copy the default waveform to ram

	; ----- Enable interrupts

	; --------------------------------------------------------------
loop:
	; Output a sample and advance

	; ----- Read the frequency knob and adjust if necessary

	; Trigger a single conversion
	lds	r25, ADCSRA
	ori	r25, (1 << ADSC)
	sts	ADCSRA, r25

	; Wait for conversion to complete
_adc_wait:
	lds	r25, ADCSRA
	sbrs	r25, ADIF    ; Test for interrupt flag
	rjmp	_adc_wait
	sts	ADCSRA, r25  ; Store back to clear the interrupt flag (w1c)

	; Read value and write to output
	lds	r25, ADCH
	out	PORTD, r25

	rjmp	loop


; ------------------------------------------------------------------------------
; Key press interrupt handler

keypress:
	; Wait for the switch bounce to settle

	; Advance to the next waveform

	; Copy the waveform to ram

	; Wait for the key to be unpressed

	; Wait for the switch bounce to settle

	reti


; ------------------------------------------------------------------------------
; Waveform data

.dseg

waveform:
	.byte	256

.cseg

sine:
	.db	0x80, 0x83, 0x86, 0x89, 0x8c, 0x8f, 0x92, 0x95
	.db	0x98, 0x9c, 0x9f, 0xa2, 0xa5, 0xa8, 0xab, 0xae
	.db	0xb0, 0xb3, 0xb6, 0xb9, 0xbc, 0xbf, 0xc1, 0xc4
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	.db	0x67, 0x6a, 0x6d, 0x70, 0x73, 0x76, 0x79, 0x7c

square:
	.db	0xff, 0xff, 0xff, 0xff, 0xff, 0xff, 0xff, 0xff
	.db	0xff, 0xff, 0xff, 0xff, 0xff, 0xff, 0xff, 0xff
	.db	0xff, 0xff, 0xff, 0xff, 0xff, 0xff, 0xff, 0xff
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	.db	0x00, 0x00, 0x00, 0x00, 0x00, 0x00, 0x00, 0x00

rising_saw:
	.db	0x00, 0x01, 0x02, 0x03, 0x04, 0x05, 0x06, 0x07
	.db	0x08, 0x09, 0x0a, 0x0b, 0x0c, 0x0d, 0x0e, 0x0f
	.db	0x10, 0x11, 0x12, 0x13, 0x14, 0x15, 0x16, 0x17
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	.db	0xf8, 0xf9, 0xfa, 0xfb, 0xfc, 0xfd, 0xfe, 0xff

falling_saw:
	.db	0xff, 0xfe, 0xfd, 0xfc, 0xfb, 0xfa, 0xf9, 0xf8
	.db	0xf7, 0xf6, 0xf5, 0xf4, 0xf3, 0xf2, 0xf1, 0xf0
	.db	0xef, 0xee, 0xed, 0xec, 0xeb, 0xea, 0xe9, 0xe8
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	.db	0x07, 0x06, 0x05, 0x04, 0x03, 0x02, 0x01, 0x00

triangle:
	.db	0x00, 0x02, 0x04, 0x06, 0x08, 0x0a, 0x0c, 0x0e
	.db	0x10, 0x12, 0x14, 0x16, 0x18, 0x1a, 0x1c, 0x1e
	.db	0x20, 0x22, 0x24, 0x26, 0x28, 0x2a, 0x2c, 0x2e
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	.db	0x0f, 0x0d, 0x0b, 0x09, 0x07, 0x05, 0x03, 0x01

white_noise:  ; Contains all values 0-255, randomized
	.db	0x7a, 0x1b, 0x50, 0xac, 0xa6, 0xf7, 0xf1, 0x82
	.db	0x6d, 0xfc, 0x24, 0x5d, 0x6e, 0xe9, 0xd6, 0x74
	.db	0x08, 0x8e, 0x28, 0xf6, 0x13, 0x22, 0xd3, 0xb1
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	.db	0xb5, 0x85, 0x44, 0x16, 0xb7, 0xcc, 0x41, 0xbd

