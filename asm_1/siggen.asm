; ------------------------------------------------------------------------------
; siggen.asm
;
; Outputs digital samples in parallel on port D[7:0] pins
; Momentary-close pushbutton on pin C5 cycles through waveforms
; Analog voltage on pin ADC0 selects frequency
; ------------------------------------------------------------------------------

.include "./m328Pdef.inc"

; ------------------------------------------------------------------------------
; Configuration

.equ	STEP_MIN = 25    ; Minimum fractional steps through LUT per cycle
.equ	STEP_MAX = 2560  ; Maximum fractional steps through LUT per cycle


; ------------------------------------------------------------------------------
; Registers

; r0  ----- Multiplication temp
; r1  ----- Multiplication temp
; r2  ----- Multiplication temp
; r3  ----- Multiplication temp
; r4  ----- Multiplication temp
; r5  ----- Multiplication temp
; r6  ----- Multiplication temp
; r7  ----- Multiplication temp
; r8
; r9
; r10
; r11
; r12
; r13
; r14 ----- Saved SREG (hare kernel clobbers flags)
; r15 ----- Hare kernel temporary
; r16 l\_   Step size within waveform LUT (8.8 fixed point)
; r17 h/
; r18
; r19 ----- Zero for adding carry
; r20 l\_   Multiplier during scaling
; r21 h/
; r22
; r23 ----- Fractional part of pointer to current sample within waveform table
; r24 ----- Second temporary
; r25 ----- First temporary
; r26 l\_X  (X) Pointer to current sample within waveform table
; r27 h/
; r28 l\_Y
; r29 h/
; r30 l\_Z  (Z) Pointer to next waveform table in rom
; r31 h/


; ------------------------------------------------------------------------------
; Hare kernel

; There are two separate "things" that need to be done repeatedly in this code,
; which I'll be calling "loop kernels":
;
; - Handle user input (waveform select button and frequency knob)
; - Output a sample from the waveform LUT
;
; User input handling can happen on a leisurely timescale (at the very least
; once every 200ms (5 Hz), and precise timing is not necessary)
;
; Sample output must happen as quickly as possible and with a fixed number of
; clock cycles between samples to prevent phase noise.
;
; I call these the "tortoise" and "hare" kernels, respectively.  The tortoise
; kernel makes up the main loop body, and it is split into 3-clock-cycle chunks
; with the hare kernel being run in between each chunk.
;
; Care must be taken to avoid register conflicts (including flags in SREG!)
;
; With 3-cycle tortoise chunks and a 5-cycle hare kernel, we can output samples
; with only 8 clock cycles between them.  With a 16 MHz clock, that yields
; 2 MSPS.

.macro HARE_KERNEL
	; ----- Output a sample
	ld	r15, X      ; 2
	out	PORTD, r15  ; 1

	; ----- Advance the sample pointer
	add	r23, r16    ; 1 Fractional part
	adc	XL, r17     ; 1 Integer low part (do not carry to high part)
.endmacro


; ------------------------------------------------------------------------------
; Interrupt vector table

.cseg

.org 0x0000
	rjmp	reset     ; RESET
	reti
	reti              ; INT0
	reti
	reti              ; INT1
	reti
	reti              ; PCINT0
	reti
	reti              ; PCINT1
	reti
	reti              ; PCINT2
	reti
	reti              ; WDT
	reti
	reti              ; TIMER2 COMPA
	reti
	reti              ; TIMER2 COMPB
	reti
	reti              ; TIMER2 OVF
	reti
	reti              ; TIMER1 CAPT
	reti
	reti              ; TIMER1 COMPA
	reti
	reti              ; TIMER1 COMPB
	reti
	reti              ; TIMER1 OVF
	reti
	reti              ; TIMER0 COMPA
	reti
	reti              ; TIMER0 COMPB
	reti
	reti              ; TIMER0 OVF
	reti
	reti              ; SPI, STC
	reti
	reti              ; USART, RX
	reti
	reti              ; USART, UDRE
	reti
	reti              ; USART, TX
	reti
	reti              ; ADC
	reti
	reti              ; EE READY
	reti
	reti              ; ANALOG COMP
	reti
	reti              ; TWI
	reti
	reti              ; SPM READY
	reti


; ------------------------------------------------------------------------------
; Reset entry point

reset:
	; ----- Disable interrupts and set stack pointer to top of SRAM

	eor	r25, r25
	out	SREG, r25
	ldi	r25, HIGH(RAMEND)
	out	SPH, r25
	ldi	r25, LOW(RAMEND)
	out	SPL, r25

	; ----- Set up PORTD for outputting samples, initial output to center of range

	ldi	r25, 0x80
	out	PORTD, r25
	ldi	r25, 0xff
	out	DDRD, r25

	; ----- Set up ADC for reading the frequency knob

	; ADEN  <= 1  Enable ADC
	; ADSC  <= 0  Do not start conversion
	; ADATE <= 0  Do not autotrigger
	; ADIF  <= 1  Clear any pending interrupt flags (just in case)
	; ADIE  <= 0  Disable ADC interrupts (we will poll ADIF)
	; ADPS  <= 7  System clock 16MHz, ADC requres <= 200kHz, scale by 128
	ldi	r25, (1 << ADEN)  | \
		     (0 << ADSC)  | \
		     (0 << ADATE) | \
		     (1 << ADIF)  | \
		     (0 << ADIE)  | \
		     (7 << ADPS0)
	sts	ADCSRA, r25

	; REFS  <= 0  Use AREF as reference
	; ADLAR <= 0  Do not left-justify results
	; MUX   <= 0  Select input ADC0
	ldi	r25, (0 << REFS0) | \
		     (0 << ADLAR) | \
		     (0 << MUX0)
	sts	ADMUX, r25

	; ADCSRB is for the comparator and autotrigger, neither are active

	; ----- Set up button pin and timer for switching waveforms

	; Set PORTC5 as input with pullup
	cbi	DDRC, DDC5
	sbi	PORTC, PORTC5

	; Allow PCINT13 (button) to trigger pin change interrupts
	ldi	r25, (1 << PCINT13)
	sts	PCMSK1, r25

	; Clear any existing pin interrupts
	in	r25, PCIFR
	out	PCIFR, r25

	; No need to set PCCSR bits since we won't actually be getting
	; interrupted, and PCISR bits will be set regardless

	; Hold prescaler in reset so timer remains halted until we need it
	ldi	r25, (1 << TSM) | \
		     (1 << PSRSYNC)
	out	GTCCR, r25

	; Timer 0: CTC mode (reset after compare match)
	;          Clock source CLK_io / 64
	ldi	r25, (1 << WGM01) | \
		     (0 << WGM00)
	out	TCCR0A, r25
	ldi	r25, (0 << WGM02) | \
		     (3 << CS00)
	out	TCCR0B, r25
	sbi	TIFR0, OCF0A  ; Make sure the timer flag is clear
	ldi	r25, 250      ; Count up to 250 (at 16MHz/64 = 250kHz -> 1ms)
	out	OCR0A, r25
	ldi	r25, 0        ; Reset the timer counter
	out	TCNT0, r25

	; ----- Set up the initial waveform

	; Point Z at the first waveform in the rom
	ldi	ZL, LOW(2*wavetable_begin)
	ldi	ZH, HIGH(2*wavetable_begin)

	; Advance waveforms to load the LUT into ram and reset the cursor
	rcall	next_waveform

	; Initial step size
	ldi	r16, LOW(STEP_MAX);0x00  ; Fractional part
	ldi	r17, HIGH(STEP_MAX);0x04  ; Integer part

	; --------------------------------------------------------------
	; Main loop
loop:
	; --------------------------------------------------------------
	; ----- Read the frequency knob

	; Trigger a single conversion
	HARE_KERNEL
	lds	r25, ADCSRA                     ; 2
	ori	r25, (1 << ADSC)                ; 1
	HARE_KERNEL
	sts	ADCSRA, r25                     ; 2
	nop                                     ; 1

	; Wait for conversion to complete
_adc_wait:
	HARE_KERNEL
	lds	r25, ADCSRA                     ; 2
	nop                                     ; 1
	HARE_KERNEL
	sbrs	r25, ADIF                       ; 1/2 Test for interrupt flag
	rjmp	_adc_wait                       ; 2
	nop                                     ; 1
	HARE_KERNEL
	sts	ADCSRA, r25                     ; 2   Store back to clear the interrupt flag (w1c)
	nop                                     ; 1

	; Read value from ADC
	HARE_KERNEL
	lds	r24, ADCL                       ; 2
	nop                                     ; 1
	HARE_KERNEL
	lds	r25, ADCH                       ; 2
	nop                                     ; 1

	; --------------------------------------------------------------
	; ----- Compute step size
	;
	; Map V in range (ADC_MIN, ADC_MAX) to (STEP_MIN, STEP_MAX)
	;
	;     /                 (STEP_MAX - STEP_MIN) \
	; X = | (V - ADC_MIN) * --------------------- | + STEP_MIN
	;     \                  (ADC_MAX - ADC_MIN)  /
	;
	; ADC_MIN = 0 and ADC_MAX = 1023 (~1024), so this can be simplified
	;
	; We do V * (STEP_MAX - STEP_MIN) first to avoid losing precision
	; Then divide by (ADC_MAX - ADC_MIN) by shifting right 10 bits
	; (Which we do by dropping the least-significant byte and shifting 2)
	;
	; 16-bit multiplication from 8-bit multiplications
	; Like multiplying two two-digit numbers, but each "digit" is now a byte
	;
	;               r25  r24
	;                 A    B  <- value from ADC
	;               r21  r20
	;            *    C    D  <- scale factor (STEP_MAX - STEP_MIN)
	;           ------------
	;                r7   r6
	;               DBH  DBL
	;           r5   r4
	;          DAH  DAL
	;           r3   r2
	;          CBH  CBL
	;      r1   r0
	;  +  CAH  CAL
	;  ---------------------
	;      r1   r0   r2   r6  <- 32-bit result

	; Get variables ready
	HARE_KERNEL
	ldi	r19, 0x00                       ; 1
	ldi	r20, LOW(STEP_MAX - STEP_MIN)   ; 1
	ldi	r21, HIGH(STEP_MAX - STEP_MIN)  ; 1

	; Generate partial products
	HARE_KERNEL
	mul	r20, r24                        ; 2
	movw	r6, r0                          ; 1
	HARE_KERNEL
	mul	r20, r25                        ; 2
	movw	r4, r0                          ; 1
	HARE_KERNEL
	mul	r21, r24                        ; 2
	movw	r2, r0                          ; 1
	HARE_KERNEL
	mul	r21, r25                        ; 2
	nop                                     ; 1

	; Add partial products
	HARE_KERNEL
	add	r4, r7                          ; 1
	adc	r3, r5                          ; 1
	in	r14, SREG                       ; 1 Save carry flag
	HARE_KERNEL
	out	SREG, r14                       ; 1 Restore carry flag
	adc	r1, r19                         ; 1 Carry only
	nop                                     ; 1
	HARE_KERNEL
	add	r2, r4                          ; 1
	adc	r0, r3                          ; 1
	in	r14, SREG                       ; 1 Save carry flag
	HARE_KERNEL
	out	SREG, r14                       ; 1 Restore carry flag
	adc	r1, r19                         ; 1 Carry only
	nop                                     ; 1
	; Full 32-bit product is in r1:r0:r2:r6

	; Shift down by 10 for division by 1024 (discard r6, shift 2)
	HARE_KERNEL
	clc                                     ; 1
	ror	r1                              ; 1
	in	r14, SREG                       ; 1 Save carry flag
	HARE_KERNEL
	out	SREG, r14                       ; 1 Restore carry flag
	ror	r0                              ; 1
	ror	r2                              ; 1
	HARE_KERNEL
	clc                                     ; 1
	ror	r1                              ; 1
	in	r14, SREG                       ; 1 Save carry flag
	HARE_KERNEL
	out	SREG, r14                       ; 1 Restore carry flag
	ror	r0                              ; 1
	ror	r2                              ; 1

	; Add offset
	HARE_KERNEL
	mov	r24, r2                         ; 1
	mov	r25, r0                         ; 1
	nop                                     ; 1
	HARE_KERNEL
	adiw	r24, STEP_MIN                   ; 2

	; Copy into step size variable
	movw	r16, r24                        ; 1

	; --------------------------------------------------------------
	; ----- Poll for button presses and swap waveforms

	HARE_KERNEL
	sbic	PINC, PINC5                     ; 1/2
	rjmp	loop                            ; 2

	; Button pin status has changed

	; Timing is no longer important, as we do not run the hare kernel here

	; Advance to next waveform in rom and copy to waveform LUT
	; Do this before the switch debouncing so the time spent copying can be
	; used as part of the wait time for the switch to settle
	rcall	next_waveform

	; Debounce, wait for button release, and debounce again
	rcall	debounce
_button_wait_release:
	sbis	PINC, PINC5
	rjmp	_button_wait_release
	rcall	debounce
	rjmp	loop


; ------------------------------------------------------------------------------
; Subroutines

next_waveform:
	; Throughout execution, Z points to the next wavetable to be loaded into
	; the waveform buffer.  This subroutine advances the Z pointer as it
	; copies, and wraps it back around to the beginning of the wavetable if
	; it reaches the end.

	; Copy the next waveform from the wavetable ROM into the waveform buffer
	ldi	XL, LOW(waveform)            ; Point X at the waveform buffer
	ldi	XH, HIGH(waveform)
	ldi	r25, 0x00
_next_waveform_loop:
	lpm	r24, Z+                      ; Load a byte from wavetale
	st	X+, r24                      ; Store it to the waveform buffer
	inc	r25                          ; Advance counter
	brne	_next_waveform_loop          ; Exit when counter overflows to zero

	; Handle wrap-around after cycling through all waveforms
	; Waveforms are all 256 bytes long, so the lower byte of Z will always
	; be the same after copying, so no need to reload it
	cpi	ZH, HIGH(2*wavetable_end)    ; Did we copy the final waveform?
	brne	_next_waveform_nowrap
	ldi	ZH, HIGH(2*wavetable_begin)  ; If so, reset to the first waveform
_next_waveform_nowrap:

	; Reset the current sample pointer
	ldi	r23, 0x00                    ; Fractional part
	ldi	XL, LOW(waveform)            ; Integer low part
	ldi	XH, HIGH(waveform)           ; Integer high part

	ret


debounce:
	; Debouncing is done by waiting for the pin to be quiet (no transitions)
	; for some specified amount of time (1ms for now, see OCR0A in the init
	; section above).
	;
	; We run the timer for 1ms and run in a busyloop until it expires.  If
	; during this loop the pin change flag indicates that there was a
	; transition, we reset the timer and wait again.

_debounce_reset:
	sbi	PCIFR, PCIF1         ; Ensure pin change flag is cleared (w1c)
	sbi	TIFR0, OCF0A         ; Ensure timer expire flag is cleared (w1c)

	; PSRSYNC resets the timer clock prescaler
	; TSM forces the prescaler to be held in reset
	ldi	r25, (1 << TSM) | \
		     (1 << PSRSYNC)
	out	GTCCR, r25           ; Reset the prescaler and halt
	ldi	r25, 0x00
	out	TCNT0, r25           ; Reset timer count value
	out	GTCCR, r25           ; Unhalt the prescaler to run the timer
_debounce_busyloop:
	sbic	PCIFR, PCIF1         ; If the pin changed again, reset and retry
	rjmp	_debounce_reset
	sbis	TIFR0, OCF0A         ; IF the timer expired, exit the loop
	rjmp	_debounce_busyloop

	ret


; ------------------------------------------------------------------------------
; Waveform data

.dseg

; Waveform table must be 256-byte aligned
; (The assembler appears to lack an "align" directive!)
.org	0x100
waveform:
	.byte	256

.cseg

; Waveform data must be contiguous
wavetable_begin:
; Sine
	.db	0x80, 0x83, 0x86, 0x89, 0x8c, 0x8f, 0x92, 0x95
	.db	0x98, 0x9c, 0x9f, 0xa2, 0xa5, 0xa8, 0xab, 0xae
	.db	0xb0, 0xb3, 0xb6, 0xb9, 0xbc, 0xbf, 0xc1, 0xc4
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	.db	0x67, 0x6a, 0x6d, 0x70, 0x73, 0x76, 0x79, 0x7c

; Square
	.db	0xff, 0xff, 0xff, 0xff, 0xff, 0xff, 0xff, 0xff
	.db	0xff, 0xff, 0xff, 0xff, 0xff, 0xff, 0xff, 0xff
	.db	0xff, 0xff, 0xff, 0xff, 0xff, 0xff, 0xff, 0xff
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	.db	0x00, 0x00, 0x00, 0x00, 0x00, 0x00, 0x00, 0x00

; Rising sawtooth
	.db	0x00, 0x01, 0x02, 0x03, 0x04, 0x05, 0x06, 0x07
	.db	0x08, 0x09, 0x0a, 0x0b, 0x0c, 0x0d, 0x0e, 0x0f
	.db	0x10, 0x11, 0x12, 0x13, 0x14, 0x15, 0x16, 0x17
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	.db	0xf8, 0xf9, 0xfa, 0xfb, 0xfc, 0xfd, 0xfe, 0xff

; Falling sawtooth
	.db	0xff, 0xfe, 0xfd, 0xfc, 0xfb, 0xfa, 0xf9, 0xf8
	.db	0xf7, 0xf6, 0xf5, 0xf4, 0xf3, 0xf2, 0xf1, 0xf0
	.db	0xef, 0xee, 0xed, 0xec, 0xeb, 0xea, 0xe9, 0xe8
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	.db	0x07, 0x06, 0x05, 0x04, 0x03, 0x02, 0x01, 0x00

; Triangle
	.db	0x00, 0x02, 0x04, 0x06, 0x08, 0x0a, 0x0c, 0x0e
	.db	0x10, 0x12, 0x14, 0x16, 0x18, 0x1a, 0x1c, 0x1e
	.db	0x20, 0x22, 0x24, 0x26, 0x28, 0x2a, 0x2c, 0x2e
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	.db	0x0f, 0x0d, 0x0b, 0x09, 0x07, 0x05, 0x03, 0x01

; White noise, contains all values 0-255, randomized
	.db	0x7a, 0x1b, 0x50, 0xac, 0xa6, 0xf7, 0xf1, 0x82
	.db	0x6d, 0xfc, 0x24, 0x5d, 0x6e, 0xe9, 0xd6, 0x74
	.db	0x08, 0x8e, 0x28, 0xf6, 0x13, 0x22, 0xd3, 0xb1
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	.db	0xb5, 0x85, 0x44, 0x16, 0xb7, 0xcc, 0x41, 0xbd
wavetable_end:

